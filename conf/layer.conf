## conf/layer.conf
```bitbake
# SPDX-FileCopyrightText: Copyright (c) 2026 Jason Perlow. All rights reserved.
# SPDX-License-Identifier: Apache-2.0
#
# meta-nclawzero — Yocto layer for ZeroClaw + NemoClaw edge agent images
#
# Pulls upstream NemoClaw and ZeroClaw at build time, applies patches,
# layers overlays, produces flashable images for Raspberry Pi and Jetson.

BBPATH .= ":${LAYERDIR}"

BBFILES += " \
    ${LAYERDIR}/recipes-*/*/*.bb \
    ${LAYERDIR}/recipes-*/*/*/*.bb \
    ${LAYERDIR}/recipes-*/*/*.bbappend \
    ${LAYERDIR}/recipes-*/*/*/*.bbappend \
"

BBFILE_COLLECTIONS += "nclawzero"
BBFILE_PATTERN_nclawzero = "^${LAYERDIR}/"
BBFILE_PRIORITY_nclawzero = "10"

LAYERDEPENDS_nclawzero = " \
    core \
    meta-python \
    openembedded-layer \
"

LAYERSERIES_COMPAT_nclawzero = "scarthgap"
```

## wic/nclawzero-jetson-dual.wks
```
# Dual-slot SD image for Jetson Orin Nano — ships with slot A installed and
# slot B empty-formatted so nclawzero-update slot-install can write to it
# without live repartitioning.
#
# layout:
#   p1  GPT="APP"   ext4 LABEL=APP_A   rootfs image (primary, boots by default)
#   p2  GPT="APP_B" ext4 LABEL=APP_B   empty ext4 (staged slot for A/B rollback)
#
# boot.slot_suffix=_nclawzero_a in the extlinux APPEND tells meta-tegra
# initrd to skip its PARTLABEL=APP blkid scan (the TYDEUS-saga root cause
# — see feedback_no_broken_drivers.md + the l4t-launcher-extlinux bbappend).
#
# NOTE: The bootloader --append below is consumed by L4TLauncher only when
# generating its OWN cmdline (rare/legacy path). The ACTIVE cmdline at boot
# is the one in /boot/extlinux/extlinux.conf, generated by the
# l4t-launcher-extlinux bbappend. Keep this in sync with the bbappend's
# NCLAWZERO_COMMON_KARGS so SD-direct dd installs (no extlinux) still get
# console-on-HDMI + earlycon.
#
# Total ~56 GB on a 64 GB card (28 GB per slot) — tune TEGRAFLASH_SDCARD_SIZE
# in machine.conf to match; dual-slot halves single-slot capacity.

bootloader --ptable gpt --append="earlycon console=tty0 console=ttyTCU0,115200 splash boot.slot_suffix=_nclawzero_a"

# Slot A — primary rootfs.
#
# GPT name (--part-name) MUST be "APP" for L4TLauncher (UEFI, in QSPI) to
# discover this partition and read /boot/extlinux/extlinux.conf from it.
# L4TLauncher hard-codes ROOTFS_BASE_NAME=L"APP" and looks for either "APP"
# or "APP_<bootchain>" where bootchain is from BootChainOsCurrent EFI var
# (defaults to 0 → "APP" when var is absent on a fresh device).
#
# The ext4 fs label (--label) is what kernel cmdline `root=LABEL=APP_A`
# resolves at mount time — uppercase-A here matches what extlinux APPEND
# sets in the bbappend. GPT name and fs label are independent.
part / --source rootfs --part-name "APP" --fstype=ext4 --label APP_A --active --align 1024 --size 28672 --fsoptions="noatime,errors=remount-ro"

# Slot B — staged rootfs (empty ext4, labelled). nclawzero-update slot-install
# writes to this partition. Mounted by ext4 LABEL via root=LABEL=APP_B in
# the primary-b extlinux APPEND. GPT name "APP_B" is descriptive; L4TLauncher
# does not boot from this partition (it only ever reads slot A's
# extlinux.conf, which contains the LABEL primary-b entry that flips root=).
part none --part-name "APP_B" --fstype=ext4 --label APP_B --align 1024 --size 28672 --fsoptions="noatime,errors=remount-ro"
```
